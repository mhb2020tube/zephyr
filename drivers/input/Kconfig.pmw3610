## drivers/input/Kconfig.pmw3610
```kconfig
# Copyright 2024 Google LLC
# SPDX-License-Identifier: Apache-2.0

config INPUT_PMW3610
	bool "PMW3610 low power laser mouse sensor input driver"
	default y
	depends on DT_HAS_PIXART_PMW3610_ENABLED
	select SPI
	help
	  PMW3610 low power laser mouse sensor input driver

config INPUT_PMW3610_POLL_INTERVAL_MS
	int "PMW3610 polling interval in ms (0 = use motion interrupt)"
	default 0
	depends on INPUT_PMW3610
	help
	  When non-zero, the driver ignores the MOTION pin and polls the
	  sensor with a burst read every N milliseconds.
```
